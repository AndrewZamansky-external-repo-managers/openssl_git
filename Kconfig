## Kconfig
```kconfig
#

config  OPENSSL_MD5
	bool   "md5"
	default n

config  OPENSSL_DES
	bool   "des"
	default n

config  OPENSSL_RSA
	bool   "rsa"
	default n

config  OPENSSL_DSA
	bool   "dsa"
	default n

config  OPENSSL_DH
	bool   "dh"
	default n

config  OPENSSL_CMS
	bool   "cms"
	default n

config  OPENSSL_EC
	bool   "ec"
	select OPENSSL_CMS
	default n
	
config  OPENSSL_SOCKET
	bool   "enable sockets"
	default n

config  OPENSSL_RIPEMD
	bool   "enable ripemd-160"
	default n


config OPENSSL_GIT_MANAGER_COMMIT_HASH
	string "OpenSSL git commit hash"
	default ""
```
